## uboot/uboot_mine/board/freescale/mx6ull_mzg_emmc/Kconfig
```kconfig
if TARGET_MX6ULL_MZG_EMMC

config SYS_BOARD
	default "mx6ull_mzg_emmc"

config SYS_VENDOR
	default "freescale"

config SYS_CONFIG_NAME
	default "mx6ull_mzg_emmc"

endif
```
